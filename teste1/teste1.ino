#include <WiFi.h>
#include <time.h>
#include <TFT_eSPI.h>

// WiFi credentials - CHANGE THESE TO YOUR NETWORK
const char* ssid = "TP-Link_7DDE";
const char* password = "18152784";

// NTP server settings for Portugal
const char* ntpServer = "pt.pool.ntp.org";
const long gmtOffset_sec = 0;      // Portugal is GMT+0 in winter
const int daylightOffset_sec = 3600; // +1 hour for daylight saving

// TFT Display setup
TFT_eSPI tft = TFT_eSPI();

// Global variables
bool wifiConnected = false;
String currentTime = "00:00";
String previousTime = "";
bool wifiStatusChanged = false;
unsigned long lastTimeUpdate = 0;
const unsigned long timeUpdateInterval = 1000;

// Animation variables
unsigned long lastFrameTime = 0;
int frameIndex = 0;
const int frameCount = 3;
const unsigned long frameDuration = 500;

// WiFi bitmaps (38x32)
static const unsigned char PROGMEM image_wifi_not_connected_bits[] = {
  0x0c,0x03,0xff,0x00,0x00,0x0c,0x03,0xff,0x00,0x00,0x03,0x3c,0x00,0xf0,0x00,
  0x03,0x3c,0x00,0xf0,0x00,0x00,0xc0,0x00,0x0f,0x00,0x00,0xc0,0x00,0x0f,0x00,
  0x0c,0x33,0xff,0x00,0xc0,0x0c,0x33,0xff,0x00,0xc0,0x30,0x0c,0x00,0xf0,0x30,
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  0x00,0x00,0x00,0x00,0x00,0x00,0x00,0x00,0x00,0x00
};

// WiFi connected bitmap (38x32) - Simple WiFi icon
static const unsigned char PROGMEM image_wifi_connected_bits[] = {
  0x00,0x03,0xff,0x00,0x00,0x00,0x03,0xff,0x00,0x00,0x00,0x3f,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0x00
};


static const uint8_t PROGMEM connect_button_frame2[] = { 
  0x00, 0x07, 0x80, 0x00, 0x00, 0x00, 0x00, 0x00, 0x07, 0xc0, 0x00, 0x00, 0x1f, 0xc0, 0x00, 0x00, 
	0x00, 0x00, 0x00, 0x0f, 0xe0, 0x00, 0x00, 0x1f, 0xc0, 0x00, 0x00, 0x00, 0x00, 0x00, 0x0f, 0xf0, 
	0x00, 0x00, 0x3f, 0xe0, 0x00, 0x00, 0x00, 0x00, 0x00, 0x1f, 0xf8, 0x00, 0x00, 0x7f, 0xc0, 0x00, 
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	0x00, 0x00, 0x00, 0x00, 0x00, 0x03, 0xc0, 0x00
 };
static const uint8_t PROGMEM connect_button_frame1[] = { 
  0x00, 0x00, 0x00, 0x00, 0x00, 0x00, 0x00, 0x00, 0x00, 0x00, 0x00, 0x00, 0x00, 0x00, 0x00, 0x00, 
	0x00, 0x00, 0x00, 0x00, 0x00, 0x00, 0x00, 0x00, 0x00, 0x00, 0x00, 0x00, 0x00, 0x00, 0x00, 0x00, 
	0x00, 0x00, 0x00, 0x00, 0x00, 0x00, 0x00, 0x00, 0x00, 0x00, 0x00, 0x00, 0x00, 0x00, 0x00, 0x00, 
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	0x00, 0x00, 0x00, 0x00, 0x00, 0x00, 0x00, 0x00
 };
static const uint8_t PROGMEM connect_button_frame0[] = { 
  0x00, 0x00, 0x00, 0x00, 0x00, 0x00, 0x00, 0x00, 0x00, 0x00, 0x00, 0x00, 0x00, 0x00, 0x00, 0x00, 
	0x00, 0x00, 0x00, 0x00, 0x00, 0x00, 0x00, 0x00, 0x00, 0x00, 0x00, 0x00, 0x00, 0x00, 0x00, 0x00, 
	0x00, 0x00, 0x00, 0x00, 0x00, 0x00, 0x00, 0x00, 0x00, 0x00, 0x00, 0x00, 0x00, 0x00, 0x00, 0x00, 
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	0x00, 0x00, 0x00, 0x00, 0x00, 0x00, 0x00, 0x00
 };


const uint8_t* connectButtonFrames[frameCount] = {
  connect_button_frame0,
  connect_button_frame1,
  connect_button_frame2
};

void setup() {
  Serial.begin(115200);
  
  // Initialize TFT display
  tft.init();
  tft.setRotation(1); // Landscape mode 480x320
  tft.fillScreen(TFT_WHITE);
  tft.setTextColor(TFT_BLACK);
  tft.setTextSize(2);
  tft.drawString("A Conectar ao WiFi...", 50, 150);
  
  // Connect WiFi
  WiFi.begin(ssid, password);
  int attempts = 0;
  while (WiFi.status() != WL_CONNECTED && attempts < 20) {
    delay(500);
    Serial.print(".");
    attempts++;
  }
  
  wifiConnected = (WiFi.status() == WL_CONNECTED);
  Serial.println(wifiConnected ? "\nWiFi conectado!" : "\nErro no Wifi!");
  if (wifiConnected) {
    Serial.print("IP: "); Serial.println(WiFi.localIP());
    configTime(gmtOffset_sec, daylightOffset_sec, ntpServer);
  }
  
  draw();
}

void loop() {
  // Update time every second
  if (millis() - lastTimeUpdate >= timeUpdateInterval) {
    updateTime();
    lastTimeUpdate = millis();
  }
  
  // Check WiFi status
  bool currentWifiStatus = (WiFi.status() == WL_CONNECTED);
  if (currentWifiStatus != wifiConnected) {
    wifiConnected = currentWifiStatus;
    wifiStatusChanged = true;
  }
  
  // Update animation frame every 500ms
  if (millis() - lastFrameTime >= frameDuration) {
    frameIndex = (frameIndex + 1) % frameCount;
    lastFrameTime = millis();
    drawConnectButtonFrame(frameIndex);
  }
  
  // Redraw entire screen if needed
  if (currentTime != previousTime || wifiStatusChanged) {
    draw();
    previousTime = currentTime;
    wifiStatusChanged = false;
  }
  
  delay(50);
}

void updateTime() {
  if (wifiConnected) {
    struct tm timeinfo;
    if (getLocalTime(&timeinfo)) {
      char timeString[6];
      strftime(timeString, sizeof(timeString), "%H:%M", &timeinfo);
      currentTime = String(timeString);
    }
  }
}

void draw() {
  tft.fillScreen(0xBDF7);             // Background
  tft.fillRect(0, 51, 480, 270, 0xCE79); // Middle section
  tft.fillRoundRect(177, 110, 125, 125, 20, 0xEF5D); // Button base
  tft.fillRect(0, 0, 480, 51, 0xEF5D);  // Top bar

  // Display time
  tft.setTextColor(TFT_BLACK);
  tft.setTextSize(4);
  tft.setTextDatum(TL_DATUM);
  tft.drawString(currentTime, 14, 9);

  // Display WiFi icon
  if (wifiConnected) {
    tft.drawBitmap(436, 8, image_wifi_connected_bits, 38, 32, TFT_BLACK);
  } else {
    tft.drawBitmap(436, 8, image_wifi_not_connected_bits, 38, 32, TFT_BLACK);
  }

  // Draw animated connect button
  drawConnectButtonFrame(frameIndex);

  // Optional WiFi status text
  tft.setTextSize(1);
  tft.setTextColor(TFT_BLACK);
  if (!wifiConnected) tft.drawString("WiFi Disconnected", 10, 280);
}

void drawConnectButtonFrame(int idx) {
  // Clear button area
  tft.fillRoundRect(177, 110, 125, 125, 20, 0xEF5D);
  // Draw frame bitmap centered inside button
  tft.drawBitmap(196, 144, connectButtonFrames[idx], 86, 56, TFT_BLACK);
}
